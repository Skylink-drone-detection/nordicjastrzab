## scan_slave/build_1/Kconfig/boards/Kconfig.nrf7002dk
```kconfig
# Load board Kconfig descriptions.
osource "C:/ncs/v3.2.4/zephyr/boards/nordic/nrf7002dk/Kconfig.nrf7002dk"
```

## scan_slave/build_1/scan_slave/Kconfig/boards/Kconfig
```kconfig
# Load Zephyr board Kconfig descriptions.
osource "C:/ncs/v3.2.4/zephyr/boards/nordic/nrf7002dk/Kconfig"
```

## scan_slave/build_1/scan_slave/Kconfig/boards/Kconfig.defconfig
```kconfig
# Load Zephyr board defconfig descriptions.
osource "C:/ncs/v3.2.4/zephyr/boards/nordic/nrf7002dk/Kconfig.defconfig"
```
